// Copyright 2022 Manna Harbour
// https://github.com/manna-harbour/miryoku
//
// Tipper TF compatibility version - mouse support removed for old ZMK fork

#include <behaviors.dtsi>
// Mouse support removed - old ZMK fork doesn't have these files
// #include <behaviors/mouse_key_press.dtsi>
#include <dt-bindings/zmk/keys.h>
#include <dt-bindings/zmk/bt.h>
#include <dt-bindings/zmk/rgb.h>
#include <dt-bindings/zmk/outputs.h>
#include <dt-bindings/zmk/ext_power.h>

#include "../miryoku/miryoku.h"

// Mouse bindings removed - old ZMK fork doesn't have this file
// #include <dt-bindings/zmk/mouse.h>

// Mouse keys disabled for old ZMK compatibility
// Define stubs BEFORE keymap so they're available when layers are expanded
#include "tipper_tf_mousekeys_stub.h"

/ {
  keymap {
    compatible = "zmk,keymap";
#define MIRYOKU_X(LAYER, STRING) \
    LAYER { \
      display-name = STRING; \
      bindings = < U_MACRO_VA_ARGS(MIRYOKU_LAYERMAPPING_##LAYER, MIRYOKU_LAYER_##LAYER) >; \
    };
MIRYOKU_LAYER_LIST
#undef MIRYOKU_X
  };
};

// Use Tipper TF compatible versions with 'label' property for old ZMK
#include "tipper_tf_shift_functions.dtsi"
#include "tipper_tf_double_tap_guard.dtsi"

#if defined (MIRYOKU_KLUDGE_THUMBCOMBOS)
  #include "../miryoku/miryoku_kludge_thumbcombos.dtsi"
#endif

#if defined (MIRYOKU_KLUDGE_TOPROWCOMBOS)
  #include "../miryoku/miryoku_kludge_toprowcombos.dtsi"
#endif

#if defined (MIRYOKU_KLUDGE_BOTTOMROWCOMBOS)
  #include "../miryoku/miryoku_kludge_bottomrowcombos.dtsi"
#endif

#if defined (MIRYOKU_KLUDGE_TAPDELAY)
  #include "../miryoku/miryoku_kludge_tapdelay.dtsi"
#else
  // Use Tipper TF compatible version with 'label' property for old ZMK
  #include "tipper_tf_behaviors.dtsi"
#endif

// Custom user combos
#include "../miryoku/custom_combos.dtsi"
